## arch/csky/Kconfig
```kconfig
menu "C-SKY architecture"
	depends on CSKY

config SYS_ARCH
	default "csky"

config CPU_CK610
	bool
	default y

choice
	prompt "Target select"
	optional

config TARGET_GX6702
	bool "NationalChip GX6702 (Gemini 6702H5)"
	select CPU_CK610
	select BOARD_LATE_INIT
	select SYS_NS16550
	select GX6702_SPI
	select SUPPORT_OF_CONTROL
	select OF_CONTROL

endchoice

source "board/nationalchip/gx6702/Kconfig"

endmenu
```

## board/nationalchip/gx6702/Kconfig
```kconfig
if TARGET_GX6702

config SYS_BOARD
	default "gx6702"

config SYS_VENDOR
	default "nationalchip"

config SYS_CONFIG_NAME
	default "gx6702"

endif

config VIDEO_GX6702
	bool "NationalChip display output (HDMI and CVBS/YPbPr)"
	depends on VIDEO && (TARGET_GX6702 || TARGET_GX6706)
	select VIDEO_DW_HDMI
	select I2C_EDID
	help
	  Drive the shared GX6702/GX6706 display path. The primary DVE at
	  0xA4804000 feeds HDMI and YPbPr. The secondary VPU/DVE at
	  0xA4900000/0xA4904000 downscales 50 Hz modes to PAL 720x576i CVBS
	  and 60 Hz modes to NTSC 720x480i CVBS. HDMI is the DesignWare TX
	  at 0xA4F00000. The output mode is picked with nationalchip,video-mode.

	  The console framebuffer is RGB and is converted to the UYVY 4:2:2
	  the graphics layer fetches. Those buffers and the vendor-sized
	  812 KiB SVPU working area are reserved from the top of DRAM.
```

## board/nationalchip/gx6706/Kconfig
```kconfig
if TARGET_GX6706

config SYS_BOARD
	default "gx6706"

config SYS_VENDOR
	default "nationalchip"

config SYS_CONFIG_NAME
	default "gx6706"

endif
```

## configs/gx6702_defconfig
```kconfig
CONFIG_CSKY=y
CONFIG_CPU_CK610=y
CONFIG_TARGET_GX6702=y
CONFIG_SYS_CONFIG_NAME="gx6702"
CONFIG_TEXT_BASE=0x93CE8420
CONFIG_HAS_CUSTOM_SYS_INIT_SP_ADDR=y
CONFIG_CUSTOM_SYS_INIT_SP_ADDR=0x93CE8420
CONFIG_SYS_MALLOC_F_LEN=0x2000
CONFIG_NR_DRAM_BANKS=1
CONFIG_SYS_LOAD_ADDR=0x92000000
CONFIG_MONITOR_IS_IN_RAM=y
CONFIG_SKIP_RELOCATE=y
CONFIG_SYS_MALLOC_CLEAR_ON_INIT=y
CONFIG_SYS_MALLOC_LEN=0x100000
CONFIG_STACK_SIZE=0x20000
CONFIG_LMB=y
CONFIG_DM=y
CONFIG_SYSINFO=y
CONFIG_SYSINFO_GX6702=y
CONFIG_OF_CONTROL=y
CONFIG_OF_EMBED=y
CONFIG_DEFAULT_DEVICE_TREE="gx6702"
CONFIG_TIMER=y
CONFIG_GX6605S_TIMER=y
CONFIG_WDT=y
CONFIG_WDT_GX6702=y
CONFIG_SYSRESET=y
CONFIG_SYSRESET_WATCHDOG=y
CONFIG_SYSRESET_WATCHDOG_AUTO=y
CONFIG_DM_SPI=y
CONFIG_GX6702_SPI=y
CONFIG_SPI=y
CONFIG_SPI_MEM=y
CONFIG_DM_SPI_FLASH=y
CONFIG_SPI_FLASH=y
CONFIG_SPI_FLASH_ATMEL=y
CONFIG_SPI_FLASH_DOSILICON=y
CONFIG_SPI_FLASH_EON=y
CONFIG_SPI_FLASH_GIGADEVICE=y
CONFIG_SPI_FLASH_ISSI=y
CONFIG_SPI_FLASH_MACRONIX=y
CONFIG_SPI_FLASH_PUYA=y
CONFIG_SPI_FLASH_SILICONKAISER=y
CONFIG_SPI_FLASH_SPANSION=y
CONFIG_SPI_FLASH_STMICRO=y
CONFIG_SPI_FLASH_SST=y
CONFIG_SPI_FLASH_WINBOND=y
CONFIG_SPI_FLASH_XMC=y
CONFIG_SPI_FLASH_XTX=y
CONFIG_SPI_FLASH_ZBIT=y
CONFIG_CMD_SF=y
CONFIG_MTD=y
CONFIG_DM_MTD=y
CONFIG_SPI_FLASH_MTD=y
CONFIG_MTD_PARTITIONS=y
CONFIG_CMD_MTD=y
CONFIG_CMD_MTDPARTS=y
CONFIG_MTDIDS_DEFAULT="nor0=spi-nor"
CONFIG_MTDPARTS_DEFAULT="mtdparts=spi-nor:64k(BOOT),512(TABLE),65024(LOGO),2688k(KERNEL),832k(ROOT),448k(DATA)"
CONFIG_GX6702_PARTITIONS=y
CONFIG_DM_GPIO=y
CONFIG_GX6702_GPIO=y
CONFIG_CMD_GPIO=y
CONFIG_VIDEO=y
CONFIG_VIDEO_GX6702=y
CONFIG_I2C_EDID=y
CONFIG_VIDEO_DAMAGE=y
CONFIG_VIDEO_LOGO=y
CONFIG_BMP_24BPP=y
CONFIG_BMP_32BPP=y
CONFIG_SYS_WHITE_ON_BLACK=y
CONFIG_CMD_HD2015=y
CONFIG_CMD_GXLOADER=y
CONFIG_SF_DEFAULT_BUS=0
CONFIG_SF_DEFAULT_CS=0
CONFIG_SF_DEFAULT_SPEED=24000000
CONFIG_SF_DEFAULT_MODE=0
CONFIG_DM_SERIAL=y
CONFIG_SYS_NS16550=y
CONFIG_SYS_NS16550_MEM32=y
CONFIG_SYS_NS16550_REG_SIZE=-4
CONFIG_SYS_NS16550_COM1=0xA0402000
CONFIG_IDENT_STRING=" GX6702"
# CONFIG_DISPLAY_CPUINFO is not set
CONFIG_DISPLAY_BOARDINFO_LATE=y
CONFIG_HUSH_PARSER=y
CONFIG_CMDLINE=y
CONFIG_CMD_BOOTM=y
# CONFIG_CMD_BOOTZ is not set
# CONFIG_CMD_BOOTI is not set
# CONFIG_CMD_BOOTD is not set
# CONFIG_EFI_LOADER is not set
# CONFIG_FIT is not set
CONFIG_LZMA=y
CONFIG_GZIP=y
# CONFIG_BZIP2 is not set
CONFIG_ZLIB=y
# CONFIG_NET is not set
# CONFIG_CMD_NET is not set
CONFIG_CMD_MEMORY=y
CONFIG_CMD_LOADB=y
CONFIG_CMD_LOADS=y
CONFIG_CMD_LOADXY_TIMEOUT=300
CONFIG_CMD_GO=y
CONFIG_CMD_RESET=y
CONFIG_CMD_WDT=y
CONFIG_CMD_FUSE=y
CONFIG_CMD_BDI=y
CONFIG_CMD_ECHO=y
CONFIG_CMD_RUN=y
CONFIG_CMD_VERSION=y
CONFIG_CMD_HELP=y
CONFIG_CMDLINE_EDITING=y
CONFIG_AUTO_COMPLETE=y
CONFIG_USB=y
CONFIG_DM_USB=y
CONFIG_CMD_USB=y
CONFIG_USB_EHCI_HCD=y
CONFIG_USB_EHCI_GENERIC=y
CONFIG_USB_OHCI_HCD=y
CONFIG_USB_OHCI_GENERIC=y
CONFIG_USB_STORAGE=y
CONFIG_FS_FAT=y
CONFIG_FAT_WRITE=y
CONFIG_CMD_FAT=y
CONFIG_PARTITIONS=y
CONFIG_DOS_PARTITION=y
CONFIG_EFI_PARTITION=y
# CONFIG_TOOLS_KWBIMAGE is not set
# CONFIG_TOOLS_LIBCRYPTO is not set
```

## configs/gx6706_defconfig
```kconfig
CONFIG_CSKY=y
CONFIG_CPU_CK610=y
CONFIG_TARGET_GX6706=y
CONFIG_SYS_CONFIG_NAME="gx6706"
CONFIG_TEXT_BASE=0x93CE8420
CONFIG_HAS_CUSTOM_SYS_INIT_SP_ADDR=y
CONFIG_CUSTOM_SYS_INIT_SP_ADDR=0x93CE8420
CONFIG_SYS_MALLOC_F_LEN=0x2000
CONFIG_NR_DRAM_BANKS=1
CONFIG_SYS_LOAD_ADDR=0x92000000
CONFIG_MONITOR_IS_IN_RAM=y
CONFIG_SKIP_RELOCATE=y
CONFIG_SYS_MALLOC_CLEAR_ON_INIT=y
CONFIG_SYS_MALLOC_LEN=0x100000
CONFIG_STACK_SIZE=0x20000
CONFIG_LMB=y
CONFIG_DM=y
CONFIG_SYSINFO=y
CONFIG_SYSINFO_GX6702=y
CONFIG_OF_CONTROL=y
CONFIG_OF_EMBED=y
CONFIG_DEFAULT_DEVICE_TREE="gx6706"
CONFIG_VIDEO=y
CONFIG_VIDEO_GX6702=y
CONFIG_I2C_EDID=y
CONFIG_VIDEO_DAMAGE=y
CONFIG_VIDEO_LOGO=y
CONFIG_BMP_24BPP=y
CONFIG_BMP_32BPP=y
CONFIG_SYS_WHITE_ON_BLACK=y
CONFIG_TIMER=y
CONFIG_GX6605S_TIMER=y
CONFIG_WDT=y
CONFIG_WDT_GX6702=y
CONFIG_SYSRESET=y
CONFIG_SYSRESET_WATCHDOG=y
CONFIG_SYSRESET_WATCHDOG_AUTO=y
CONFIG_DM_SPI=y
CONFIG_GX6706_SPI=y
CONFIG_SPI=y
CONFIG_SPI_MEM=y
CONFIG_DM_SPI_FLASH=y
CONFIG_SPI_FLASH=y
CONFIG_SPI_FLASH_ATMEL=y
CONFIG_SPI_FLASH_DOSILICON=y
CONFIG_SPI_FLASH_EON=y
CONFIG_SPI_FLASH_GIGADEVICE=y
CONFIG_SPI_FLASH_ISSI=y
CONFIG_SPI_FLASH_MACRONIX=y
CONFIG_SPI_FLASH_PUYA=y
CONFIG_SPI_FLASH_SILICONKAISER=y
CONFIG_SPI_FLASH_SPANSION=y
CONFIG_SPI_FLASH_STMICRO=y
CONFIG_SPI_FLASH_SST=y
CONFIG_SPI_FLASH_WINBOND=y
CONFIG_SPI_FLASH_XMC=y
CONFIG_SPI_FLASH_XTX=y
CONFIG_SPI_FLASH_ZBIT=y
CONFIG_SPI_FLASH_BOYA=y
CONFIG_SPI_FLASH_ESMT=y
CONFIG_SPI_FLASH_FIDELIX=y
CONFIG_SPI_FLASH_FMD=y
CONFIG_SPI_FLASH_FUDAN=y
CONFIG_SPI_FLASH_GIANTEC=y
CONFIG_SPI_FLASH_PARAGON=y
CONFIG_SPI_FLASH_PMC=y
CONFIG_SPI_FLASH_SIXIN=y
CONFIG_SPI_FLASH_UCUNDATA=y
CONFIG_SPI_FLASH_ZETTA=y
CONFIG_CMD_SF=y
CONFIG_MTD=y
CONFIG_DM_MTD=y
CONFIG_SPI_FLASH_MTD=y
CONFIG_MTD_PARTITIONS=y
CONFIG_CMD_MTD=y
CONFIG_CMD_MTDPARTS=y
CONFIG_MTDIDS_DEFAULT="nor0=spi-nor"
CONFIG_MTDPARTS_DEFAULT="mtdparts=spi-nor:128k(BOOT),512(TABLE),65024(LOGO),2176k(KERNEL),448k(ROOT),1280k(DATA)"
CONFIG_GX6702_PARTITIONS=y
CONFIG_SF_DEFAULT_BUS=0
CONFIG_SF_DEFAULT_CS=0
CONFIG_SF_DEFAULT_SPEED=24000000
CONFIG_SF_DEFAULT_MODE=0
CONFIG_DM_SERIAL=y
CONFIG_SYS_NS16550=y
CONFIG_SYS_NS16550_MEM32=y
CONFIG_SYS_NS16550_REG_SIZE=-4
CONFIG_SYS_NS16550_COM1=0xA0402000
CONFIG_IDENT_STRING=" GX6706"
# CONFIG_DISPLAY_CPUINFO is not set
CONFIG_DISPLAY_BOARDINFO_LATE=y
CONFIG_HUSH_PARSER=y
CONFIG_CMDLINE=y
CONFIG_CMD_BOOTM=y
# CONFIG_CMD_BOOTZ is not set
# CONFIG_CMD_BOOTI is not set
# CONFIG_CMD_BOOTD is not set
# CONFIG_EFI_LOADER is not set
# CONFIG_FIT is not set
CONFIG_LZMA=y
CONFIG_GZIP=y
# CONFIG_BZIP2 is not set
CONFIG_ZLIB=y
CONFIG_BOARD_INIT=y
CONFIG_NET=y
CONFIG_CMD_NET=y
CONFIG_CMD_DHCP=y
CONFIG_CMD_PING=y
CONFIG_DM_DMA=y
CONFIG_ETH_DESIGNWARE_GX6706=y
CONFIG_PHY_REALTEK=y
CONFIG_CMD_MII=y
CONFIG_CMD_MEMORY=y
CONFIG_CMD_LOADB=y
CONFIG_CMD_LOADS=y
CONFIG_CMD_LOADXY_TIMEOUT=300
CONFIG_CMD_GO=y
CONFIG_CMD_RESET=y
CONFIG_CMD_WDT=y
CONFIG_CMD_HD2015=y
CONFIG_CMD_GXLP=y
CONFIG_CMD_FUSE=y
CONFIG_CMD_BDI=y
CONFIG_CMD_ECHO=y
CONFIG_CMD_RUN=y
CONFIG_CMD_VERSION=y
CONFIG_CMD_HELP=y
CONFIG_CMDLINE_EDITING=y
CONFIG_AUTO_COMPLETE=y
CONFIG_USB=y
CONFIG_DM_USB=y
CONFIG_CMD_USB=y
CONFIG_USB_EHCI_HCD=y
CONFIG_USB_EHCI_GENERIC=y
CONFIG_USB_OHCI_HCD=y
CONFIG_USB_OHCI_GENERIC=y
CONFIG_USB_STORAGE=y
CONFIG_FS_FAT=y
CONFIG_FAT_WRITE=y
CONFIG_CMD_FAT=y
CONFIG_PARTITIONS=y
CONFIG_DOS_PARTITION=y
CONFIG_EFI_PARTITION=y
# CONFIG_TOOLS_KWBIMAGE is not set
# CONFIG_TOOLS_LIBCRYPTO is not set
CONFIG_LTO=y
CONFIG_OPTIMIZE_INLINING=y
```
